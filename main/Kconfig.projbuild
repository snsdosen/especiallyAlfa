## main/Kconfig.projbuild
```kconfig
menu "MediaDev build configuration"

config MD_MODEL
  string "MediaDev model indicator"
  help
    Model identifier of the module

config MD_HARDWARE_REVISION
  hex "Hardware revision"
  range 0x0 0x99
  default 0x10
  help
    Hardware revision of the module

config MD_FIRMWARE_VERSION
  hex "Firmware version"
  range 0x0 0x99
  default 0x10
  help
    Firmware version of the module

config MD_BUILD_NUMBER
  int "Build number"
  range 0 65535
  default 1
  help
    Firmware build number

config DEBUG_SIGNATURE
  bool "Flag as debug build"
  help
    Mark as debug version of the application

config BUS_LISTEN_MODE
  bool "Bus listen mode, don't reply"
  help
    Only listen on a radio bus, don't reply

config SHOW_BUS_DEBUG
  bool "Print radio bus messages"
  help
    Show radio bus messages in console

config SHOW_TEXTCOM_DEBUG
  bool "Print radio text bus messages"
  help
    Show radio text bus messages in console

config DISABLE_PWRMGR
  bool "Disable power manager deep sleep"
  help
    Disable deep sleep when it's not desired to have it running
    
endmenu

menu "A2DP Configuration"
    config EXAMPLE_LOCAL_DEVICE_NAME
        string "Local Device Name"
        default "especiallyAlfa"
        help
            Use this option to set local device name.

    config EXAMPLE_A2DP_SINK_USE_EXTERNAL_CODEC
        bool "Use External Codec Instead of Internal"
        default n
        select BT_A2DP_USE_EXTERNAL_CODEC
        help
            If enable, Bluedroid stack will not decode A2DP audio data, user need to decode it in application layer.

endmenu
```
